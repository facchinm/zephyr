## boards/arduino/giga_r1/Kconfig.defconfig
```kconfig
# Copyright 2023 Google LLC
# SPDX-License-Identifier: Apache-2.0

if BOARD_ARDUINO_GIGA_R1

if WIFI || BT

# Select AIROC part and module
choice AIROC_PART
	default CYW4343W
endchoice

choice CYW4343W_MODULE
	default CYW4343W_MURATA_1DX
endchoice

endif # WIFI || BT

if WIFI

config DISK_DRIVER_SDMMC
	default y

config SDMMC_STM32
	default y

config WIFI_AIROC
	default y

# Enable L2 Ethernet
config NET_L2_ETHERNET
	default y

endif # WIFI

if BT

# Select HCI components
config UART
	bool
	default y

endif # BT

# Heap Pool Size
config HEAP_MEM_POOL_ADD_SIZE_BOARD
	int
	default 15000 if WIFI
	default 4096

endif # BOARD_ARDUINO_GIGA_R1
```

## drivers/wifi/esp_hosted/Kconfig.esp_hosted
```kconfig
# ESP Hosted WiFi driver options

# Copyright (c) 2025 Arduino SA
# SPDX-License-Identifier: Apache-2.0

menuconfig WIFI_ESP_HOSTED
	bool "ESP_HOSTED driver support"
	depends on DT_HAS_ESPRESSIF_ESP_HOSTED_ENABLED
	default y
	select GPIO
	select SPI
	select WIFI_OFFLOAD
	select NET_L2_ETHERNET
	select NET_L2_WIFI_MGMT
	select WIFI_USE_NATIVE_NETWORKING

if WIFI_ESP_HOSTED
config WIFI_ESP_HOSTED_DEBUG
	bool "Enable extra debugging messages"
	help
	  Enable stack debugging messages.
endif
```
