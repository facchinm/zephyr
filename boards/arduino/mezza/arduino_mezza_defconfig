## boards/arduino/mezza/arduino_mezza_defconfig
```kconfig
# SPDX-License-Identifier: Apache-2.0

# enable uart driver
CONFIG_SERIAL=y

# console
CONFIG_CONSOLE=y
CONFIG_UART_CONSOLE=y

# enable GPIO
CONFIG_GPIO=y

CONFIG_USB_DEVICE_STACK_NEXT=y
CONFIG_USBD_CDC_ACM_CLASS=y

CONFIG_WIFI_ST67W611M1=y
CONFIG_MODEM_CONTEXT_VERBOSE_DEBUG=y
CONFIG_MODEM_LOG_LEVEL_DBG=y
CONFIG_LOG=y
CONFIG_LOG_MODE_IMMEDIATE=y

CONFIG_SPI_LOG_LEVEL_WRN=y
CONFIG_FS_LOG_LEVEL_DBG=y

CONFIG_FS_SAMPLE_CREATE_SOME_ENTRIES=y

# Arduino format FAT volumes using a 4096 bytes sector size.
CONFIG_FS_FATFS_MAX_SS=4096

CONFIG_DISK_LOG_LEVEL_DBG=y
CONFIG_SD_LOG_LEVEL_DBG=y

CONFIG_SPI_STM32_INTERRUPT=y
#CONFIG_SPI_STM32_DMA=y
```

## boards/arduino/plin/Kconfig.arduino_plin
```kconfig
# Copyright 2021,2023 NXP
# SPDX-License-Identifier: Apache-2.0

config BOARD_ARDUINO_PLIN
	select SOC_PART_NUMBER_MIMXRT1176DVMAA
	select SOC_MIMXRT1176_CM7 if BOARD_ARDUINO_PLIN_MIMXRT1176_CM7
	select SOC_MIMXRT1176_CM4 if BOARD_ARDUINO_PLIN_MIMXRT1176_CM4
```

## boards/arduino/plin/arduino_plin_mimxrt1176_cm7_defconfig
```kconfig
#
# Copyright 2021,2023 NXP
#
# SPDX-License-Identifier: Apache-2.0
#

CONFIG_CONSOLE=y
CONFIG_UART_CONSOLE=y
CONFIG_SERIAL=y
CONFIG_GPIO=y
CONFIG_ARM_MPU=y
CONFIG_HW_STACK_PROTECTION=y
CONFIG_FLEXSPI_CONFIG_BLOCK_OFFSET=0x400
CONFIG_PINCTRL=y
CONFIG_SDIO_STACK=y
#CONFIG_USE_DT_CODE_PARTITION=y
CONFIG_NXP_IMXRT_BOOT_HEADER=y

# Enable USB Stack (needed for the console to work)
#CONFIG_USB_DEVICE_STACK=y
CONFIG_SHELL=y
CONFIG_ETH_NXP_ENET_1G=y
CONFIG_BT_H4_NXP_CTLR=y
CONFIG_BT_NXP_NW612=y
CONFIG_ENTROPY_GENERATOR=y
CONFIG_USB_DEVICE_VID=0x2341
CONFIG_USB_DEVICE_PID=0x0075

CONFIG_ETH_NXP_ENET_HW_ACCELERATION=y
CONFIG_NET_IF_MAX_IPV4_COUNT=4

#CONFIG_TEST_RANDOM_GENERATOR=y

CONFIG_REGULATOR=y
CONFIG_REGULATOR_FIXED_INIT_PRIORITY=50
CONFIG_ETH_INIT_PRIORITY=83
CONFIG_MDIO_INIT_PRIORITY=81
CONFIG_PHY_INIT_PRIORITY=82
CONFIG_PHY_LOG_LEVEL_DBG=y
CONFIG_NET_SHELL=y

CONFIG_TICKLESS_KERNEL=n

CONFIG_BT_RX_STACK_SIZE=8192
CONFIG_BT_HCI_TX_STACK_SIZE=8192
CONFIG_BT_BUF_ACL_RX_COUNT_EXTRA=3
CONFIG_BT_MAX_CONN=3

CONFIG_LOG=y
#CONFIG_EARLY_CONSOLE=y
#CONFIG_LOG_MODE_IMMEDIATE=y
#CONFIG_LOG_DEFAULT_LEVEL=3
CONFIG_BT_HCI_DRIVER_LOG_LEVEL_INF=y
#CONFIG_BT_LOG_LEVEL_DBG=y
#CONFIG_BT_HCI_CORE_LOG_LEVEL_DBG=y

CONFIG_WIFI_NXP=y
CONFIG_NXP_IW61X=y
#CONFIG_NXP_WIFI_SHELL=y
CONFIG_NXP_IW612_MURATA_2EL_USD=y
CONFIG_NXP_IW61X_REGION_EU=y
CONFIG_NXP_WIFI_MAX_AP_ENTRIES=6
CONFIG_NXP_WIFI_RF_TEST_MODE=n

CONFIG_REQUIRES_FULL_LIBC=y
CONFIG_CBPRINTF_FP_SUPPORT=y

# wifi driver
CONFIG_NXP_WIFI_TX_TASK_PRIO=3
CONFIG_NXP_WIFI_DRIVER_TASK_PRIO=3

# log
CONFIG_WIFI_LOG_LEVEL_DBG=y

CONFIG_EVENTS=y
CONFIG_NET_MGMT_EVENT=y
CONFIG_NET_MGMT_EVENT_STACK_SIZE=8192
CONFIG_HEAP_MEM_POOL_SIZE=32768
```

## boards/arduino/plin/board.yml
```yaml
board:
  name: arduino_plin
  full_name: Arduino Plin
  vendor: arduino
  socs:
    - name: mimxrt1176
```
